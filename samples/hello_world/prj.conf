## CMakeLists.txt
```
# SPDX-License-Identifier: Apache-2.0

cmake_minimum_required(VERSION 3.13.1)

include($ENV{ZEPHYR_BASE}/cmake/app/boilerplate.cmake NO_POLICY_SCOPE)
project(hello_world)

target_sources(app PRIVATE src/main.c)
add_subdirectory(liba)
target_link_libraries(app PRIVATE liba)
```

## prj.conf
```kconfig
# nothing here
CONFIG_NRFX_TWIM=y
CONFIG_I2C=y
CONFIG_I2C_NRFX=y
CONFIG_I2C_2=y
CONFIG_NO_OPTIMIZATIONS=y
CONFIG_SPI=y
CONFIG_SPI_3=y
CONFIG_SPI_NRFX=y
CONFIG_SPI_1=n
#CONFIG_TRUSTED_EXECUTION_NONSECURE=y
CONFIG_UART_1_NRF_UARTE=n
CONFIG_UART_1_NRF_TX_BUFFER_SIZE=32
```

## src/main.c
```c
/*
 * Copyright (c) 2012-2014 Wind River Systems, Inc.
 *
 * SPDX-License-Identifier: Apache-2.0
 */

#include <zephyr.h>
//#include <sys/printk.h>
#include <liba.h>

void main(void)
{
	printk("Hello World! %r\n", dupa());
}
```
