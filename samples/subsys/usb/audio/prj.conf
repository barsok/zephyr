## CMakeLists.txt
```
cmake_minimum_required(VERSION 3.13.1)
include($ENV{ZEPHYR_BASE}/cmake/app/boilerplate.cmake NO_POLICY_SCOPE)
project(audio)

FILE(GLOB app_sources src/*.c)
target_sources(app PRIVATE ${app_sources})

add_subdirectory(erpc)
target_link_libraries(app PRIVATE testrpc)
```

## prj.conf
```kconfig
CONFIG_STDOUT_CONSOLE=y

#USB related configs
CONFIG_USB=y
CONFIG_USB_DEVICE_STACK=y
CONFIG_USB_DEVICE_PRODUCT="Zephyr USB audio sample"
CONFIG_LOG=y
CONFIG_LOG_DEFAULT_LEVEL=4
CONFIG_USB_DRIVER_LOG_LEVEL_DBG=y
CONFIG_USB_DEVICE_LOG_LEVEL_DBG=y
CONFIG_LOG_BUFFER_SIZE=8192
CONFIG_USB_AUDIO=y
```

## src/main.c
```c
/*
 * TODO
 */

#include <zephyr.h>
#include <logging/log.h>
LOG_MODULE_REGISTER(main);

extern void usb_log_status(void);

void main(void)
{
	LOG_INF("entered main.");


	while(1)
	{
		usb_log_status();
		k_sleep(200);
	}
}
```
