## drivers/i2s/Kconfig.nrfx
```kconfig
# Kconfig - nrfx I2S driver configuration options
#
# Copyright (c) 2018 STMicroelectronics
#
# SPDX-License-Identifier: Apache-2.0
#

menuconfig I2S_NRFX
	bool "NRFX I2S controller driver"
	depends on I2S && HAS_HW_NRF_I2S
	default n
	help
	  Enable nrfx I2S support for Nordic CPUs

if I2S_NRFX

config I2S_NRFX_RX_BLOCK_COUNT
	int "RX queue length"
	default 4

config I2S_NRFX_TX_BLOCK_COUNT
	int "TX queue length"
	default 4

endif # I2S_NRFX
```

## dts/bindings/i2s/nordic,nrfx-i2s.yaml
```yaml
---
title: Nordic I2S
version: 0.1

description: >
    This binding gives a base representation of the Nordic I2S

inherits:
    !include i2s.yaml

properties:
    compatible:
      constraint: "nordic,nrf-i2s"

    reg:
      type: array
      description: mmio register space
      generation: define
      category: required

    interrupts:
      type: array
      category: required
      description: required interrupts
      generation: define

    mck-pin:
      type: int
      description: MCK pin
      generation: define
      category: required

    sck-pin:
      type: int
      description: SCK pin
      generation: define
      category: required

    lrck-pin:
      type: int
      description: LRCK pin
      generation: define
      category: optional

    sdout-pin:
      type: int
      description: SDOUT pin
      generation: define
      category: optional

    sdin-pin:
      type: int
      description: SDIN pin
      generation: define
      category: optional
...
```
